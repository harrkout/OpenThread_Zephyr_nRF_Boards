## Code/Dongle/coprocessor/build/Kconfig/arch/Kconfig
```kconfig
# Load Zephyr Arch Kconfig descriptions.
osource "/home/harrkout/zephyr_workspace/ncs/toolchains/v2.9.0/zephyr/arch/x86/Kconfig"
osource "/home/harrkout/zephyr_workspace/ncs/toolchains/v2.9.0/zephyr/arch/xtensa/Kconfig"
osource "/home/harrkout/zephyr_workspace/ncs/toolchains/v2.9.0/zephyr/arch/sparc/Kconfig"
osource "/home/harrkout/zephyr_workspace/ncs/toolchains/v2.9.0/zephyr/arch/riscv/Kconfig"
osource "/home/harrkout/zephyr_workspace/ncs/toolchains/v2.9.0/zephyr/arch/posix/Kconfig"
osource "/home/harrkout/zephyr_workspace/ncs/toolchains/v2.9.0/zephyr/arch/nios2/Kconfig"
osource "/home/harrkout/zephyr_workspace/ncs/toolchains/v2.9.0/zephyr/arch/mips/Kconfig"
osource "/home/harrkout/zephyr_workspace/ncs/toolchains/v2.9.0/zephyr/arch/arm64/Kconfig"
osource "/home/harrkout/zephyr_workspace/ncs/toolchains/v2.9.0/zephyr/arch/arm/Kconfig"
osource "/home/harrkout/zephyr_workspace/ncs/toolchains/v2.9.0/zephyr/arch/arc/Kconfig"
```

## Code/Dongle/coprocessor/build/Kconfig/boards/Kconfig.defconfig
```kconfig
# Load Zephyr board defconfig descriptions.
osource "/home/harrkout/zephyr_workspace/ncs/toolchains/v2.9.0/zephyr/boards/nordic/nrf52840dongle/Kconfig.defconfig"
```

## Code/Dongle/coprocessor/build/coprocessor/Kconfig/Kconfig.shield.defconfig
```kconfig
osource "/home/harrkout/zephyrproject/harrkout/coprocessor/boards/shields/*/Kconfig.defconfig"
osource "/home/harrkout/zephyr_workspace/ncs/toolchains/v2.9.0/nrf/boards/shields/*/Kconfig.defconfig"
```

## Code/Dongle/coprocessor/build/coprocessor/Kconfig/boards/Kconfig.nrf52840dongle
```kconfig
# Load board Kconfig descriptions.
osource "/home/harrkout/zephyr_workspace/ncs/toolchains/v2.9.0/zephyr/boards/nordic/nrf52840dongle/Kconfig.nrf52840dongle"
```
