## prj.conf
```kconfig
#
# Copyright (c) 2020 Nordic Semiconductor
#
# SPDX-License-Identifier: LicenseRef-Nordic-5-Clause
#

# Network shell
CONFIG_SHELL=y
CONFIG_OPENTHREAD_SHELL=y
CONFIG_SHELL_ARGC_MAX=26
CONFIG_SHELL_CMD_BUFF_SIZE=416

# Increase Settings storage size
CONFIG_PM_PARTITION_SIZE_SETTINGS_STORAGE=0x8000

# Enable OpenThread features set
CONFIG_OPENTHREAD_NORDIC_LIBRARY_MASTER=y

CONFIG_NET_L2_OPENTHREAD=y

# Generic networking options
CONFIG_NETWORKING=y

CONFIG_GPIO_SHELL=y

CONFIG_THREAD_RUNTIME_STATS=y

# Enable USB Device support
# CONFIG_USB_DEVICE=y
CONFIG_USB_DEVICE_STACK=y

# Enable CDC ACM (for UART over USB)
CONFIG_USB_CDC_ACM=y

CONFIG_SCHED_THREAD_USAGE=y
CONFIG_SCHED_THREAD_USAGE_ALL=y
CONFIG_SCHED_THREAD_USAGE_ANALYSIS=y
CONFIG_THREAD_MONITOR=y

CONFIG_CPU_LOAD=y
CONFIG_CPU_LOAD_LOG_INTERVAL=2000
CONFIG_CPU_LOAD_LOG_PERIODIC=y

CONFIG_NETWORKING=y
CONFIG_NET_IPV6=y
CONFIG_NET_UDP=y
# CONFIG_OPENTHREAD=y
# CONFIG_OPENTHREAD_UDP=y
CONFIG_OPENTHREAD_COMMISSIONER=y
CONFIG_OPENTHREAD_JOINER=y
CONFIG_OPENTHREAD_DIAG=y
CONFIG_OPENTHREAD_SHELL=y
```

## src/main.c
```c
/**
 * @file cli_leader.c
 * @brief Command Line Interface (CLI) application for Zephyr OS.
 * @author Harry Koutsourelakis
 * @email harrkout@gmail.com
 * @company Intelligent Systems and Computer Architecture (ISCA) Lab
 * @date March 2025
 * @version 1.0
 */

#include <zephyr/kernel.h>
#include <zephyr/logging/log.h>
#include <string.h>
#include <zephyr/usb/usb_device.h>
#include <zephyr/shell/shell.h>
#include <zephyr/drivers/uart.h>
#include <zephyr/shell/shell.h>
#include <stdlib.h>
#include <time.h>
#include <stdio.h>

#if defined(CONFIG_CLI_SAMPLE_MULTIPROTOCOL)
#include "ble.h"
#endif

#if defined(CONFIG_CLI_SAMPLE_LOW_POWER)
#include "low_power.h"
#endif

LOG_MODULE_REGISTER(cli_sample, CONFIG_OT_COMMAND_LINE_INTERFACE_LOG_LEVEL);

volatile bool float_computation_enabled = false;
volatile bool int_computation_enabled = false;
volatile bool fibonacci_calculation_enabled = false;

#define STACK_SIZE_FLOAT_COMP 1024
#define STACK_SIZE_INT_COMP 3072
#define STACK_SIZE_FIB_CALC 1024
#define STACK_SIZE_UDP_SEND 1024
#define THREAD_PRIORITY 7

static K_THREAD_STACK_DEFINE(float_comp_stack, STACK_SIZE_FLOAT_COMP);
static K_THREAD_STACK_DEFINE(int_comp_stack, STACK_SIZE_INT_COMP);
static K_THREAD_STACK_DEFINE(fib_calc_stack, STACK_SIZE_FIB_CALC);
static K_THREAD_STACK_DEFINE(udp_send_stack, STACK_SIZE_UDP_SEND);

static struct k_thread float_comp_thread, int_comp_thread, fib_calc_thread, udp_send_thread;

static void float_computation_thread(void *p1, void *p2, void *p3)
{
    volatile float counter = 0.0f;
    while (1) {
        if (float_computation_enabled) {
            LOG_INF("Starting floating-point computation...");
            float total = 0.0f;
            for (int i = 0; i < 50000; i++) {
                counter += (float)i * 2.0f;
                total = counter;
                if (i % 10000 == 0) {
                    LOG_INF("Floating-point computation progress: %d/50000", i);
                    k_yield();
                }
            }
            LOG_INF("Floating-point computation completed. Total accumulated value: %f", total);
            counter = 0.0f;
            k_msleep(1000);
        } else {
            k_msleep(100);
        }
    }
}

static void int_computation_thread(void *p1, void *p2, void *p3)
{
    volatile uint32_t counter = 0;
    while (1) {
        if (int_computation_enabled) {
            LOG_INF("Starting integer computation...");
            uint32_t total = 0;
            for (int i = 0; i < 50000; i++) {
                counter += i * 2;
                total = counter;
                if (i % 10000 == 0) {
                    LOG_INF("Integer computation progress: %d/50000", i);
                    k_yield();
                }
            }
            LOG_INF("Integer computation completed. Total accumulated value: %u", total);
            counter = 0;
            k_msleep(1000);
        } else {
            k_msleep(100);
        }
    }
}

static int fibonacci(int n) {
    int a = 0, b = 1, c;
    if (n == 0) return a;
    for (int i = 2; i <= n; i++) {
        c = a + b;
        a = b;
        b = c;
        if (i % 100 == 0) {
            LOG_INF("Calculating Fibonacci(%d)...", i);
            k_yield();
        }
    }
    return b;
}

static void fibonacci_calculation_thread(void *p1, void *p2, void *p3)
{
    while (1) {
        if (fibonacci_calculation_enabled) {
            LOG_INF("Starting Fibonacci(500) calculation...");
            int result = fibonacci(500);
            LOG_INF("Fibonacci(500) result: %d", result);
            k_msleep(1000);
        } else {
            k_msleep(100);
        }
    }
}

static void handle_udp_command(const char *command)
{
    if (strncmp(command, "enable_float", 12) == 0) {
        float_computation_enabled = true;
        LOG_INF("Floating-point computation enabled via UDP");
    }
    else if (strncmp(command, "disable_float", 13) == 0) {
        float_computation_enabled = false;
        LOG_INF("Floating-point computation disabled via UDP");
    }
    else if (strncmp(command, "enable_int", 10) == 0) {
        int_computation_enabled = true;
        LOG_INF("Integer computation enabled via UDP");
    }
    else if (strncmp(command, "disable_int", 11) == 0) {
        int_computation_enabled = false;
        LOG_INF("Integer computation disabled via UDP");
    }
    else if (strncmp(command, "enable_fibonacci", 16) == 0) {
        fibonacci_calculation_enabled = true;
        LOG_INF("Fibonacci calculation enabled via UDP");
    }
    else if (strncmp(command, "disable_fibonacci", 17) == 0) {
        fibonacci_calculation_enabled = false;
        LOG_INF("Fibonacci calculation disabled via UDP");
    }
    else {
        LOG_WRN("Unknown UDP command: %s", command);
    }
}

static void enable_float_computation(const struct shell *shell, size_t argc, char **argv) {
    float_computation_enabled = true;
    shell_print(shell, "Floating-point computation enabled");
}

static void disable_float_computation(const struct shell *shell, size_t argc, char **argv) {
    float_computation_enabled = false;
    shell_print(shell, "Floating-point computation disabled");
}

static void enable_int_computation(const struct shell *shell, size_t argc, char **argv) {
    int_computation_enabled = true;
    shell_print(shell, "Integer computation enabled");
}

static void disable_int_computation(const struct shell *shell, size_t argc, char **argv) {
    int_computation_enabled = false;
    shell_print(shell, "Integer computation disabled");
}

static void enable_fibonacci_calculation(const struct shell *shell, size_t argc, char **argv) {
    fibonacci_calculation_enabled = true;
    shell_print(shell, "Fibonacci calculation enabled");
}

static void disable_fibonacci_calculation(const struct shell *shell, size_t argc, char **argv) {
    fibonacci_calculation_enabled = false;
    shell_print(shell, "Fibonacci calculation disabled");
}

static int cmd_status(const struct shell *shell, size_t argc, char **argv)
{
    shell_print(shell, "Current Status:");
    shell_print(shell, "- Floating-point Computation: %s", 
               float_computation_enabled ? "ACTIVE" : "INACTIVE");
    shell_print(shell, "- Integer Computation: %s", 
               int_computation_enabled ? "ACTIVE" : "INACTIVE");
    shell_print(shell, "- Fibonacci Calculation: %s", 
               fibonacci_calculation_enabled ? "ACTIVE" : "INACTIVE");
    return 0;
}

SHELL_STATIC_SUBCMD_SET_CREATE(
    sub_function,
    SHELL_CMD(enable_float, NULL, "Enable floating-point computation", enable_float_computation),
    SHELL_CMD(disable_float, NULL, "Disable floating-point computation", disable_float_computation),
    SHELL_CMD(enable_int, NULL, "Enable integer computation", enable_int_computation),
    SHELL_CMD(disable_int, NULL, "Disable integer computation", disable_int_computation),
    SHELL_CMD(enable_fibonacci, NULL, "Enable Fibonacci calculation", enable_fibonacci_calculation),
    SHELL_CMD(disable_fibonacci, NULL, "Disable Fibonacci calculation", disable_fibonacci_calculation),
    SHELL_CMD(status, NULL, "Show current command status", cmd_status),
    SHELL_SUBCMD_SET_END
);

SHELL_CMD_REGISTER(commands, &sub_function, "CPU workload management commands", NULL);

static void udp_send_thread_func(void *p1, void *p2, void *p3)
{
    const struct shell *shell = shell_backend_uart_get_ptr();
    int buffer[6];
    char msg[32];
    char command[96];

    while (1) {
        int offset = 0;
        for (int i = 0; i < 6; i++) {
            buffer[i] = rand() % 100;
            offset += snprintf(msg + offset, sizeof(msg) - offset, (i == 0) ? "%d" : ",%d", buffer[i]);
            if (offset >= sizeof(msg) - 1) break;
        }
        msg[offset] = '\0';

        snprintf(command, sizeof(command), "ot udp send fe80::b866:a487:ef8a:5e85 1234 %s", msg);
        shell_fprintf(shell, SHELL_NORMAL, "\nSending: %s\n", msg);

        int err = shell_execute_cmd(shell, command);
        if (err != 0) shell_fprintf(shell, SHELL_ERROR, "Command failed: %d\n", err);
        
        k_sleep(K_SECONDS(3));
    }
}

void send_ot_commands(const struct shell *shell) {
    const char *commands[] = {
        "ot dataset channel 15",
        "ot dataset panid 0x1234",
        "ot dataset networkname \"OpenThreadDemo\"",
        "ot dataset extpanid 1111111122222222",
        "ot dataset networkkey 00112233445566778899aabbccddeeff",
        "ot dataset commit active",
        "ot ifconfig up",
        "ot thread start",
        "ot state",
        "ot udp open",
        "ot udp bind :: 1234"
    };

    for (size_t i = 0; i < sizeof(commands) / sizeof(commands[0]); i++) {
        shell_fprintf(shell, SHELL_NORMAL, "Executing: %s\n", commands[i]);
        shell_execute_cmd(shell, commands[i]);
        k_sleep(K_SECONDS(1));
    }

    LOG_INF("OpenThread stack initialized and ready.");
}

void main(void) {
    const struct shell *shell = shell_backend_uart_get_ptr();
    srand(time(NULL));
    send_ot_commands(shell);

    k_thread_create(&float_comp_thread, float_comp_stack, 
                    K_THREAD_STACK_SIZEOF(float_comp_stack),
                    float_computation_thread, NULL, NULL, NULL,
                    THREAD_PRIORITY, 0, K_NO_WAIT);
    k_thread_create(&int_comp_thread, int_comp_stack, 
                    K_THREAD_STACK_SIZEOF(int_comp_stack),
                    int_computation_thread, NULL, NULL, NULL,
                    THREAD_PRIORITY, 0, K_NO_WAIT);
    k_thread_create(&fib_calc_thread, fib_calc_stack, 
                    K_THREAD_STACK_SIZEOF(fib_calc_stack),
                    fibonacci_calculation_thread, NULL, NULL, NULL,
                    THREAD_PRIORITY, 0, K_NO_WAIT);

   // Create the UDP send thread
    k_thread_create(&udp_send_thread, udp_send_stack, 
                    K_THREAD_STACK_SIZEOF(udp_send_stack),
                    udp_send_thread_func, NULL, NULL, NULL,
                    THREAD_PRIORITY, 0, K_NO_WAIT);

    while (1) {
        k_msleep(1000);
    }

    return 0;
}
```

## src/checkpoint_main.c
```c
#include <zephyr/kernel.h>
#include <zephyr/logging/log.h>
#include <string.h>
#include <zephyr/usb/usb_device.h>
#include <zephyr/shell/shell.h>
#include <zephyr/drivers/uart.h>

#if defined(CONFIG_CLI_SAMPLE_MULTIPROTOCOL)
#include "ble.h"
#endif

#if defined(CONFIG_CLI_SAMPLE_LOW_POWER)
#include "low_power.h"
#endif

LOG_MODULE_REGISTER(cli_sample, CONFIG_OT_COMMAND_LINE_INTERFACE_LOG_LEVEL);

// Function control flags
volatile bool func_1_enabled = false;  // Add volatile for flag access
volatile bool func_2_enabled = false;
volatile bool func_3_enabled = false;

// Adjusted thread configurations
#define STACK_SIZE_FUNC1 1024
#define STACK_SIZE_FUNC2 3072  // Larger stack for sorting
#define STACK_SIZE_FUNC3 1024
#define THREAD_PRIORITY 7      // Lower priority than shell (which typically uses 4)

static K_THREAD_STACK_DEFINE(stack1, STACK_SIZE_FUNC1);
static K_THREAD_STACK_DEFINE(stack2, STACK_SIZE_FUNC2);
static K_THREAD_STACK_DEFINE(stack3, STACK_SIZE_FUNC3);

static struct k_thread thread1, thread2, thread3;

/* CPU-intensive functions with yields */
static void function_1_thread(void *p1, void *p2, void *p3)
{
    volatile uint32_t counter = 0;
    while (1) {
        if (func_1_enabled) {
            for (int i = 0; i < 50000; i++) {  // Reduced iterations
                counter += i * 2;
                if (i % 1000 == 0) k_yield();  // Yield periodically
            }
            counter = 0;
            k_msleep(10);
        } else {
            k_msleep(100);
        }
    }
}

static void function_2_thread(void *p1, void *p2, void *p3)
{
    int data[200];  // Reduced array size
    while (1) {
        if (func_2_enabled) {
            // Generate random data
            for (int i = 0; i < ARRAY_SIZE(data); i++) {
                data[i] = k_cycle_get_32() % 1000;
            }
            
            // Bubble sort with yield
            for (int i = 0; i < ARRAY_SIZE(data)-1; i++) {
                for (int j = 0; j < ARRAY_SIZE(data)-i-1; j++) {
                    if (data[j] > data[j+1]) {
                        int temp = data[j];
                        data[j] = data[j+1];
                        data[j+1] = temp;
                    }
                }
                k_yield();  // Yield after each outer loop iteration
            }
            k_msleep(10);
        } else {
            k_msleep(100);
        }
    }
}

static int fibonacci(int n) {
    int a = 0, b = 1, c;
    if (n == 0) return a;
    for (int i = 2; i <= n; i++) {
        c = a + b;
        a = b;
        b = c;
        if (i % 100 == 0) k_yield();  // Yield periodically
    }
    return b;
}

static void function_3_thread(void *p1, void *p2, void *p3)
{
    while (1) {
        if (func_3_enabled) {
            volatile int result = fibonacci(500);  // Reduced from 1000
            (void)result;
            k_msleep(10);
        } else {
            k_msleep(100);
        }
    }
}

/* Shell command handlers */
static void enable_function_1(const struct shell *shell, size_t argc, char **argv) {
    func_1_enabled = true;
    shell_print(shell, "Function 1 (Sensor Simulation) Enabled");
}

static void disable_function_1(const struct shell *shell, size_t argc, char **argv) {
    func_1_enabled = false;
    shell_print(shell, "Function 1 (Sensor Simulation) Disabled");
}

static void enable_function_2(const struct shell *shell, size_t argc, char **argv) {
    func_2_enabled = true;
    shell_print(shell, "Function 2 (Data Processing) Enabled");
}

static void disable_function_2(const struct shell *shell, size_t argc, char **argv) {
    func_2_enabled = false;
    shell_print(shell, "Function 2 (Data Processing) Disabled");
}

static void enable_function_3(const struct shell *shell, size_t argc, char **argv) {
    func_3_enabled = true;
    shell_print(shell, "Function 3 (CPU Usage Report) Enabled");
}

static void disable_function_3(const struct shell *shell, size_t argc, char **argv) {
    func_3_enabled = false;
    shell_print(shell, "Function 3 (CPU Usage Report) Disabled");
}

SHELL_STATIC_SUBCMD_SET_CREATE(
    sub_function,
    SHELL_CMD(enable_func1, NULL, "Enable Function 1 (Sensor Simulation)", enable_function_1),
    SHELL_CMD(disable_func1, NULL, "Disable Function 1 (Sensor Simulation)", disable_function_1),
    SHELL_CMD(enable_func2, NULL, "Enable Function 2 (Data Processing)", enable_function_2),
    SHELL_CMD(disable_func2, NULL, "Disable Function 2 (Data Processing)", disable_function_2),
    SHELL_CMD(enable_func3, NULL, "Enable Function 3 (CPU Usage Report)", enable_function_3),
    SHELL_CMD(disable_func3, NULL, "Disable Function 3 (CPU Usage Report)", disable_function_3),
    SHELL_SUBCMD_SET_END
);

SHELL_CMD_REGISTER(functions, &sub_function, "Functions submenu", NULL);

int main(void) {
    /* ... (keep existing main() initialization code unchanged) ... */

    // Create threads with adjusted priorities
    k_thread_create(&thread1, stack1, K_THREAD_STACK_SIZEOF(stack1),
                    function_1_thread, NULL, NULL, NULL,
                    THREAD_PRIORITY, 0, K_NO_WAIT);
    k_thread_create(&thread2, stack2, K_THREAD_STACK_SIZEOF(stack2),
                    function_2_thread, NULL, NULL, NULL,
                    THREAD_PRIORITY, 0, K_NO_WAIT);
    k_thread_create(&thread3, stack3, K_THREAD_STACK_SIZEOF(stack3),
                    function_3_thread, NULL, NULL, NULL,
                    THREAD_PRIORITY, 0, K_NO_WAIT);

    while (1) {
        k_msleep(1000);
    }

    return 0;
}
```
